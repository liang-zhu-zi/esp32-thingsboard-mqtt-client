## Kconfig
```kconfig
menu "ThingsBoard MQTT Client library (TBMQTTClient)"

    config ESP_TBMQTTCLIENT_TASK_STACK_SIZE
        int "ThingsBoard MQTT Client (TBMQTTClient) task stack size"
        range 512 65536 if !APPTRACE_ENABLE
        range 2048 65536 if APPTRACE_ENABLE
        default 2048 if APPTRACE_ENABLE
        default 1536
        help
            Configure the IPC tasks stack size. An IPC task runs on each core (in dual core mode), and allows for
            cross-core function calls. See IPC documentation for more details. The default IPC stack size should be
            enough for most common simple use cases. However, users can increase/decrease the stack size to their
            needs.

    config ESP_TBMQTTCLIENT_USES_CALLERS_PRIORITY
        bool "TBMQTTClient runs at caller's priority"
        default y
        depends on !FREERTOS_UNICORE
        help
            If this option is not enabled then the IPC task will keep behavior same as prior to that of ESP-IDF v4.0,
            hence IPC task will run at (configMAX_PRIORITIES - 1) priority.

endmenu # "ThingsBoard MQTT Client library (TBMQTTClient)
```

## components/tbcm/Kconfig
```kconfig
menu "ThingsBoard MQTT Client library (TBMQTTClient)"

    config TB_MQTT_CLIENT_HELPER_ENABLE
        bool "Enable TBMQTTClient Helper"
        default y
        # depends on json
        help
            Use a more simplified API with cJSON.

endmenu # "ThingsBoard MQTT Client library (TBMQTTClient)
```

## examples/authentication/a12_access_token_with_onewayssl/main/Kconfig.projbuild
```kconfig
menu "Example Configuration"

    config TBC_TRANSPORT_ADDRESS_HOST
        string "Hostname, to set ipv4 pass it as string"
        default ""
        help
            Hostname to connect to server/broker

    config TBC_TRANSPORT_ADDRESS_PORT
        int "Port"
        default 8883
        help
            MQTT over TCP:1883. MQTT over SSL: 8883. MQTT over WebSocket:80. MQTT over WebSocket Secure:443.

    config TBC_TRANSPORT_ACCESS_TOKEN
        string "Access Token"
        default ""
        help
            Access token to connect to broker

    config TBC_TRANSPORT_SKIP_CERT_COMMON_NAME_CHECK
        prompt "Skip any validation of server certificate CN field"
        bool
        default true
        help 
            Skip any validation of server certificate CN field, this reduces the 
            security of TLS and makes the mqtt client susceptible to MITM attacks

endmenu
```

## examples/authentication/a21_basic_mqtt_credential_c_wo_ssl/main/Kconfig.projbuild
```kconfig
menu "Example Configuration"

    config TBC_TRANSPORT_ADDRESS_HOST
        string "Hostname, to set ipv4 pass it as string"
        default ""
        help
            Hostname to connect to server/broker

    config TBC_TRANSPORT_ADDRESS_PORT
        int "Port"
        default 1883
        help
            MQTT over TCP:1883. MQTT over SSL: 8883. MQTT over WebSocket:80. MQTT over WebSocket Secure:443.

    config TBC_TRANSPORT_CREDENTIALS_CLIENT_ID
        string "Client ID"
        default ""
        help
            Client ID to connect to broker

endmenu
```

## examples/provision/pd11_dev_sup_access_token_wo_ssl/main/Kconfig.projbuild
```kconfig
menu "Example ThingsBoard MQTT Configuration"

    menu "Transport server address"
        config TBC_TRANSPORT_ADDRESS_HOST
            string "Hostname, to set ipv4 pass it as string"
            default ""
            help
                Hostname to connect to server/broker

        config TBC_TRANSPORT_ADDRESS_PORT
            int "Port"
            default 1883 if TBC_TRANSPORT_ADDRESS_SHEMA_USE_MQTT
            default 8883 if TBC_TRANSPORT_ADDRESS_SHEMA_USE_MQTTS
            # default 80   if TBC_TRANSPORT_ADDRESS_SHEMA_USE_MQTT_WS
            # default 443  if TBC_TRANSPORT_ADDRESS_SHEMA_USE_MQTT_WSS
            # default 80   if TBC_TRANSPORT_ADDRESS_SHEMA_USE_HTTP
            # default 80   if TBC_TRANSPORT_ADDRESS_SHEMA_USE_HTTPS
            # default 5683 if TBC_TRANSPORT_ADDRESS_SHEMA_USE_COAP
            # default 5684 if TBC_TRANSPORT_ADDRESS_SHEMA_USE_COAPS
            help
                MQTT over TCP:1883. MQTT over SSL: 8883. MQTT over WebSocket:80. MQTT over WebSocket Secure:443.
    endmenu

    menu "Provisioning config"
        config TBC_PROVISION_DEVICE_NAME
            string "Device name (Optional)"
            default ""
            help
                e.g., ESP32 chip ID

        config TBC_PROVISION_DEVICE_KEY
            string "Device key"
            default ""
            help
                ThingsBoard --> Device profiles --> Click a row --> Device provisiong --> Provison device key.

        config TBC_PROVISION_DEVICE_SECRET
            string "Device secret"
            default ""
            help
                ThingsBoard --> Device profiles --> Click a row --> Device provisiong --> Provison device secret.

        config TBC_PROVISION_TOKEN
            string "Token"
            default ""
    endmenu

    menu "Transport verification / Server certificate"
        depends on (TBC_TRANSPORT_ADDRESS_SHEMA_USE_MQTTS)
            # || TBC_TRANSPORT_ADDRESS_SHEMA_USE_MQTT_WSS \
            # || TBC_TRANSPORT_ADDRESS_SHEMA_USE_HTTPS \
            # || TBC_TRANSPORT_ADDRESS_SHEMA_USE_COAPS

        config TBC_TRANSPORT_USE_CERT_PEM
            prompt "Use certificate data in PEM format for server verify (with SSL)"
            bool

        config TBC_TRANSPORT_SKIP_CERT_COMMON_NAME_CHECK
            prompt "Skip any validation of server certificate CN field"
            bool
            help 
                Skip any validation of server certificate CN field, this reduces the 
                security of TLS and makes the mqtt client susceptible to MITM attacks
    endmenu
endmenu
```

## examples/provision/ps20_srv_gen_credentials_w_onewayssl/main/Kconfig.projbuild
```kconfig
menu "Example ThingsBoard MQTT Configuration"

    menu "Transport server address"
        config TBC_TRANSPORT_ADDRESS_HOST
            string "Hostname, to set ipv4 pass it as string"
            default ""
            help
                Hostname to connect to server/broker

        config TBC_TRANSPORT_ADDRESS_PORT
            int "Port"
            default 8883 
            help
                MQTT over TCP:1883. MQTT over SSL: 8883. MQTT over WebSocket:80. MQTT over WebSocket Secure:443.
    endmenu

    menu "Provisioning config"
        config TBC_PROVISION_DEVICE_NAME
            string "Device name (Optional)"
            default ""
            help
                e.g., ESP32 chip ID

        config TBC_PROVISION_DEVICE_KEY
            string "Device key"
            default ""
            help
                ThingsBoard --> Device profiles --> Click a row --> Device provisiong --> Provison device key.

        config TBC_PROVISION_DEVICE_SECRET
            string "Device secret"
            default ""
            help
                ThingsBoard --> Device profiles --> Click a row --> Device provisiong --> Provison device secret.

    endmenu
 
    menu "Transport verification / Server certificate"
        config TBC_TRANSPORT_SKIP_CERT_COMMON_NAME_CHECK
            prompt "Skip any validation of server certificate CN field"
            bool
        default true
            help 
                Skip any validation of server certificate CN field, this reduces the 
                security of TLS and makes the mqtt client susceptible to MITM attacks
    endmenu

endmenu
```
